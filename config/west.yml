## config/west.yml
```yaml
manifest:
  remotes:
    - name: zmkfirmware
      url-base: https://github.com/zmkfirmware
    - name: gpeye
      url-base: https://github.com/GPeye
    - name: englmaxi
      url-base: https://github.com/englmaxi
    - name: mctechnology17
      url-base: https://github.com/mctechnology17
  projects:
    - name: hammerbeam-slideshow
      remote: gpeye
      revision: main 
    - name: zmk
      remote: zmkfirmware
      revision: v0.3.0
      import: app/west.yml
    - name: zmk-dongle-display
      remote: englmaxi
      revision: main
    - name: zmk-nice-oled
      remote: mctechnology17
      revision: main
  self:
    path: config
```
